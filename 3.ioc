# file: 3.ioc
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Mcu.Family=STM32F1
Mcu.Name=STM32F103C(4-6)Tx
Mcu.Package=LQFP48
NVIC.PriorityGroup=NVIC_PRIORITYGROUP_4
PC13-TAMPER-RTC.GPIO_Speed=GPIO_SPEED_FREQ_HIGH
PC13-TAMPER-RTC.Signal=GPIO_Output
PD0-OSC_IN.Mode=HSE-External-Oscillator
PD0-OSC_IN.Signal=RCC_OSC_IN
PD1-OSC_OUT.Mode=HSE-External-Oscillator
PD1-OSC_OUT.Signal=RCC_OSC_OUT
ProjectManager.HeapSize=0x200
ProjectManager.StackSize=0x400
ProjectManager.TargetToolchain=MDK-ARM V5.27
RCC.AHBFreq_Value=72000000
RCC.APB1CLKDivider=RCC_HCLK_DIV2
RCC.APB1Freq_Value=36000000
RCC.APB1TimFreq_Value=72000000
RCC.APB2Freq_Value=72000000
RCC.APB2TimFreq_Value=72000000
RCC.HCLKFreq_Value=72000000
RCC.PLLMUL=RCC_PLL_MUL9
RCC.PLLSourceVirtual=RCC_PLLSOURCE_HSE
RCC.SYSCLKFreq_VALUE=72000000
RCC.SYSCLKSource=RCC_SYSCLKSOURCE_PLLCLK
RCC.USBFreq_Value=72000000
VP_SYS_VS_ND.Mode=No_Debug
board=custom

// file: Src/main.c
/* USER CODE BEGIN Header */
/**
  ******************************************************************************
  * @file           : main.c
  * @brief          : Main program body
  ******************************************************************************
  * @attention
  *
  * <h2><center>&copy; Copyright (c) 2022 STMicroelectronics.
  * All rights reserved.</center></h2>
  *
  * This software component is licensed by ST under BSD 3-Clause license,
  * the "License"; You may not use this file except in compliance with the
  * License. You may obtain a copy of the License at:
  *                        opensource.org/licenses/BSD-3-Clause
  *
  ******************************************************************************
  */
/* USER CODE END Header */

#include "main.h"
#include "gpio.h"
#include "dz.h"
#include "dzcode.h"

/* USER CODE BEGIN PTD */
typedef enum
{
	KEY_Check,			//�������
	KEY_Press,			//��������
	KEY_Release,		//�����ͷ�
	Key_Over,
}KEY_State;
/* USER CODE END PTD */

/* USER CODE BEGIN PD */
#define B1 HAL_GPIO_ReadPin(GPIOB,GPIO_PIN_9)

/* USER CODE END PD */

/* USER CODE BEGIN PV */
uint16_t Num=0;
uint8_t KEY_Value=0;
KEY_State KeyState=KEY_Check;
uint8_t KEY_Flag = 0;
uint32_t KEY_Press_TIME=20;

char zero[8][8]={0};
int flag_z=0;
int flag_zz=0;

/* USER CODE END PV */

void SystemClock_Config(void);

int main(void)
{

  /* MCU Configuration--------------------------------------------------------*/

  /* Reset of all peripherals, Initializes the Flash interface and the Systick. */
  HAL_Init();

  /* USER CODE BEGIN Init */
  MX_GPIO_Init();
  /* USER CODE BEGIN 2 */
	MX_GPIO_Init_A();
	MX_GPIO_Init_B();
  /* USER CODE END Init */

  /* Configure the system clock */
  SystemClock_Config();

  /* Initialize all configured peripherals */
  MX_GPIO_Init();
  /* USER CODE BEGIN 2 */
	uint16_t data=0;
  /* USER CODE END 2 */
//R88_row_flush();//ˢ����
//R88_col_flush();//ˢ����
R88_off();//�ر�����
  /* Infinite loop */
  /* USER CODE BEGIN WHILE */
  while (1)
  {
//		HAL_GPIO_WritePin(GPIOA,GPIO_PIN_4,1);
//		R88_off();

//		Display(biglove,1);
//		HAL_Delay(100);
//		Display(biglove,0);
//		HAL_Delay(100);
//		Display(smalllove,1);
//		HAL_Delay(100);
//		Display(smalllove,0);
//		HAL_Delay(100);
//		Display(twelve,1);
//		HAL_Delay(100);
//		Display(twelve,0);
//		HAL_Delay(100);
//		Display(q_min,1);
//		HAL_Delay(100);
//		Display(q_min,0);
//		HAL_Delay(100);
//		Display(as,1);
//		HAL_Delay(100);
//		Display(as,0);
//		HAL_Delay(100);
		if(KEY_Flag==1)
		{
			KEY_Flag=0;
			if((KEY_Value==1)&&(KEY_Press_TIME<=700)){data++; HAL_GPIO_TogglePin(GPIOC,GPIO_PIN_13);}
			else if((KEY_Value==1)&&(KEY_Press_TIME>1200)){data=99;HAL_GPIO_TogglePin(GPIOC,GPIO_PIN_13);}
			KEY_Press_TIME=20;
		}
		//##################��
		if(data==0)
		{

			// disply_z();
			// Display_plus(biglove,1,20);
			// data++;
		circle();

		}
		if(data==1) Display(zero);

		//################## С��
		if(data==2)
		{
			Display_plus(smalllove,1,20);
			data++;
		}
		if(data==3) Display(smalllove);

		//################## 12
		if(data==4)
		{
			Display_plus(twelve,1,30);
			data++;
		}
		if(data==5) Display(twelve);

		//################## 0101
		if(data==6)
		{
			Display_plus(q_min,1,20);
			data++;
		}
		if(data==7) Display(q_min);

		//################## FF
		if(data==8)
		{
			Display_plus(q_max,1,20);
			data++;
		}
		if(data==9) Display(q_max);

		if(data==11)
		{
			R88_on();
			HAL_Delay(100);
			R88_off();
			HAL_Delay(100);
		}
		if(data==12)data=0;
		if(data==99) Display(as);

		if(data==100)data=0;
		if(data==101)data=0;
//		else
//		{
//			Display(biglove,1);
//		//HAL_Delay(200);
//		}
    /* USER CODE BEGIN 3 */
  }
    /* USER CODE BEGIN 3 */
  /* USER CODE END 3 */
}

void SystemClock_Config(void)
{
  RCC_OscInitTypeDef RCC_OscInitStruct = {0};
  RCC_ClkInitTypeDef RCC_ClkInitStruct = {0};

  /** Initializes the CPU, AHB and APB busses clocks
  */
//  RCC_OscInitStruct.OscillatorType = RCC_OSCILLATORTYPE_HSE;
//  RCC_OscInitStruct.HSEState = RCC_HSE_ON;
//  RCC_OscInitStruct.HSEPredivValue = RCC_HSE_PREDIV_DIV1;
//  RCC_OscInitStruct.HSIState = RCC_HSI_ON;
//  RCC_OscInitStruct.PLL.PLLState = RCC_PLL_ON;
//  RCC_OscInitStruct.PLL.PLLSource = RCC_PLLSOURCE_HSE;
//  RCC_OscInitStruct.PLL.PLLMUL = RCC_PLL_MUL9;

  if (HAL_RCC_OscConfig(&RCC_OscInitStruct) != HAL_OK)
  {
    Error_Handler();
  }
  /** Initializes the CPU, AHB and APB busses clocks
  */
  RCC_ClkInitStruct.ClockType = RCC_CLOCKTYPE_HCLK|RCC_CLOCKTYPE_SYSCLK
                              |RCC_CLOCKTYPE_PCLK1|RCC_CLOCKTYPE_PCLK2;
  RCC_ClkInitStruct.SYSCLKSource = RCC_SYSCLKSOURCE_PLLCLK;
  RCC_ClkInitStruct.AHBCLKDivider = RCC_SYSCLK_DIV1;
  RCC_ClkInitStruct.APB1CLKDivider = RCC_HCLK_DIV2;
  RCC_ClkInitStruct.APB2CLKDivider = RCC_HCLK_DIV1;

  if (HAL_RCC_ClockConfig(&RCC_ClkInitStruct, FLASH_LATENCY_2) != HAL_OK)
  {
    Error_Handler();
  }
}

/* USER CODE BEGIN 4 */
void KeyScan(void)
{
	switch(KeyState)
	{
		case KEY_Check:
		{

			if(B1==GPIO_PIN_RESET)
			{KeyState=KEY_Press;
				//HAL_GPIO_TogglePin(GPIOC,GPIO_PIN_13);
			};
		}
		break;
		case KEY_Press:
		{
			if(B1==GPIO_PIN_RESET)KEY_Value=1;
			KeyState=KEY_Release;
		}
		break;
		case KEY_Release:
		{
			if(B1==GPIO_PIN_RESET)
			{
				KEY_Press_TIME=KEY_Press_TIME+10;
			}
			else
			{
				KeyState=KEY_Check;
				KEY_Flag=1;
			}
		}
		break;
		default:break;
	}
}
/* USER CODE END 4 */

void Error_Handler(void)
{
}

/************************ (C) COPYRIGHT STMicroelectronics *****END OF FILE****/
